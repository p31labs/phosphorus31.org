## firmware/node-one-esp-idf/main/Kconfig.projbuild
```kconfig
menu "Node One Configuration"

    config NODE_ONE_DEVICE_NAME
        string "Device Name"
        default "P31-Node-One"

    config NODE_ONE_LORA_FREQ
        int "LoRa Frequency (MHz x 10)"
        default 9150
        help
            LoRa frequency in MHz * 10. 9150 = 915.0 MHz.

    config NODE_ONE_WIFI_SSID
        string "WiFi AP SSID"
        default "P31-NodeOne"

    config NODE_ONE_WIFI_PASS
        string "WiFi AP Password"
        default "phenixnavigator"

endmenu
```

## firmware/node-one-esp-idf/sdkconfig.defaults
```kconfig
# Node One - ESP32-S3 Configuration
# Waveshare ESP32-S3-Touch-LCD-3.5B

CONFIG_IDF_TARGET="esp32s3"

# CPU Frequency
CONFIG_ESP_DEFAULT_CPU_FREQ_MHZ_240=y

# Flash Configuration (16 MB)
CONFIG_ESPTOOLPY_FLASHSIZE_16MB=y
CONFIG_ESPTOOLPY_FLASHMODE_QIO=y
CONFIG_ESPTOOLPY_FLASHFREQ_80M=y

# Octal PSRAM Configuration
CONFIG_SPIRAM=y
CONFIG_SPIRAM_MODE_OCT=y
CONFIG_SPIRAM_SPEED_80M=y
CONFIG_SPIRAM_FETCH_INSTRUCTIONS=y
CONFIG_SPIRAM_RODATA=y

# Partition Table
CONFIG_PARTITION_TABLE_CUSTOM=y
CONFIG_PARTITION_TABLE_CUSTOM_FILENAME="partitions.csv"
# No OTA for MVP - removed otadata partition

# FreeRTOS
CONFIG_FREERTOS_HZ=1000

# Compiler Optimization
CONFIG_COMPILER_OPTIMIZATION_PERF=y

# Console (USB Serial JTAG)
CONFIG_ESP_CONSOLE_USB_SERIAL_JTAG=y

# LVGL Configuration
CONFIG_LV_COLOR_16_SWAP=y
CONFIG_LV_FONT_MONTSERRAT_12=y
CONFIG_LV_FONT_MONTSERRAT_16=y
CONFIG_LV_FONT_MONTSERRAT_20=y
CONFIG_LV_MEM_CUSTOM=y

# Codec Configuration
CONFIG_CODEC_I2C_BACKWARD_COMPATIBLE=n

# HTTP Server WebSocket Support
CONFIG_HTTPD_WS_SUPPORT=y

# Bluetooth Configuration
CONFIG_BT_ENABLED=y
CONFIG_BT_NIMBLE_ENABLED=y
CONFIG_BT_NIMBLE_ROLE_PERIPHERAL=y
CONFIG_BT_NIMBLE_ROLE_BROADCASTER=y
CONFIG_BT_NIMBLE_MAX_CONNECTIONS=1
CONFIG_BT_NIMBLE_EXT_ADV=n
CONFIG_BT_NIMBLE_MAX_BONDS=1
```
